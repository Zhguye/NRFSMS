## CMakeLists.txt
```
#
# Copyright (c) 2021 Nordic Semiconductor
#
# SPDX-License-Identifier: LicenseRef-Nordic-5-Clause
#

cmake_minimum_required(VERSION 3.20.0)

find_package(Zephyr REQUIRED HINTS $ENV{ZEPHYR_BASE})
project(sms_1)

# NORDIC SDK APP START
target_sources(app PRIVATE src/main.c)
target_sources(app PRIVATE src/connect_example.c)

# NORDIC SDK APP END
```

## Kconfig
```
#
# Copyright (c) 2021 Nordic Semiconductor ASA
#
# SPDX-License-Identifier: LicenseRef-Nordic-5-Clause
#

menu "SMS Sample Settings"

config SMS_SEND_PHONE_NUMBER
	string "+358451115666"
	default "+358451115666"

endmenu

menu "Zephyr Kernel"
source "Kconfig.zephyr"
endmenu
```

## prj.conf
```kconfig
#
# Copyright (c) 2021 Nordic Semiconductor ASA
#
# SPDX-License-Identifier: LicenseRef-Nordic-5-Clause
#
# General config



CONFIG_SMS_SEND_PHONE_NUMBER="+358451115666"

CONFIG_SMS=y
CONFIG_SMS_SUBSCRIBERS_MAX_CNT=2
CONFIG_SMS_LOG_LEVEL_DBG=n
CONFIG_MAIN_STACK_SIZE=4096

# Networking
CONFIG_NETWORKING=y
CONFIG_NET_SOCKETS=y
CONFIG_NET_SOCKETS_OFFLOAD=y
CONFIG_NRF_MODEM_LIB=y
CONFIG_POSIX_API=y

# LTE link control
CONFIG_LTE_LINK_CONTROL=y
CONFIG_MODEM_INFO=y
CONFIG_NETWORKING=y
CONFIG_NET_STATISTICS=y


# AT commands
CONFIG_AT_HOST_LIBRARY=y
CONFIG_AT_CMD_CUSTOM=y


# Debugging
CONFIG_LOG=y
CONFIG_ASSERT=y
CONFIG_ASSERT_VERBOSE=y
```

## src/main.c
```c
#include <stdio.h>
#include <zephyr/kernel.h>
#include <zephyr/logging/log.h>
#include <modem/sms.h>
#include <modem/lte_lc.h>
#include <modem/modem_info.h>
#include <modem/nrf_modem_lib.h>
#include <stdbool.h>
#include "connect_example.h"
#include <string.h>
#include <nrf_modem_at.h> 
#include <zephyr/sys/printk.h>




LOG_MODULE_REGISTER(sms_1, LOG_LEVEL_DBG);

char payload343[255];


static void sms_callback(struct sms_data *const data, void *context)
{
	if (data == NULL) {
		printk("%s with NULL data\n", __func__);
		return;
	}

	if (data->type == SMS_TYPE_DELIVER) {
		/* When SMS message is received, print information */
		struct sms_deliver_header *header = &data->header.deliver;

		printk("\nSMS received:\n");
		printk("\tTime:   %02d-%02d-%02d %02d:%02d:%02d\n",
			header->time.year,
			header->time.month,
			header->time.day,
			header->time.hour,
			header->time.minute,
			header->time.second);

		printk("\tText:   '%s'\n", data->payload);
		memset(payload343, 0, sizeof(payload343));
		memcpy(payload343, data->payload, data->payload_len);
		printk("\t payload343:%s", payload343);
		printk("\tLength: %d\n", data->payload_len);

		if (header->app_port.present) {
			printk("\tApplication port addressing scheme: dest_port=%d, src_port=%d\n",
				header->app_port.dest_port,
				header->app_port.src_port);
		}
		if (header->concatenated.present) {
			printk("\tConcatenated short message: ref_number=%d, msg %d/%d\n",
				header->concatenated.ref_number,
				header->concatenated.seq_number,
				header->concatenated.total_msgs);
		}
	} else if (data->type == SMS_TYPE_STATUS_REPORT) {
		printk("SMS status report received\n");
	} else {
		printk("SMS protocol message with unknown type received\n");
	}

	
}




 //char networkdata[];
 //char voltagedata[];
 //char temperaturedata[];
 char response_data[422];
 


		
void respond_with_modem_data() {
   
   

	char cell_id[128];
	char temperature[128];
	char rsrp[128];
	
 modem_info_string_get(MODEM_INFO_CELLID, cell_id, sizeof(cell_id));
 modem_info_string_get(MODEM_INFO_TEMP, temperature, sizeof(temperature));
 modem_info_string_get(MODEM_INFO_RSRP, rsrp, sizeof(rsrp));

	/* Format sensor data into the response buffer, 
	I tried different ideas to add all the responses into 1 string and snprintf seemed easier than sprintf, however did not test possible errors with different print fuctions*/
    snprintf(response_data, sizeof(response_data),
             "Temperature: %s  C, RSRP: %s dBm, Cell ID: %s \n",
             temperature, rsrp, cell_id);
    // Log the response data
    printk(" data in respond function:%s", response_data);
}

	//Main section of the code, what happens when code device receives SMS and what it decides to return.
void respond_to_payload() {
	int ret =0;
	printk(" Respond in payload function : %s\n",payload343);
    if (strcmp(payload343, "network") == 0) {
		 respond_with_modem_data();
		ret=sms_send_text(CONFIG_SMS_SEND_PHONE_NUMBER,response_data);
		printk("SMS sent to Onomondo\n");
			if (ret) {
				printk("Sending SMS failed with error: %d\n", ret);
				}
    } 
			if(strcmp(payload343, "stop") == 0){
				k_msleep(1000);
			}
				/*	Other Options, Unused		
		else if (strcmp(payload343, "voltage") == 0) {
        	printf("Response: %s\n", voltagedata);
    } 	else if (strcmp(payload343, "temp") == 0) {
        	printf("Response: %s\n", temperaturedata);
    } 	*/else {
        	printf("Error request, option not found. Try network, voltage, or temp \n");
    }
}





int main(void)
{
	int32_t retval = 0;
	int ret = 0;
	int handle = 0;
	//int err;
	struct modem_param_info modem_info;


	
	
	
  	modem_info_init();
    

    /* Get modem information */
    modem_info_params_init(&modem_info);
   
		

		//FW_VERSION is defined in CMakeLists.txt
	LOG_INF("Started SMS base application version %s", "3.20.0");
	retval = nrf_modem_lib_init();
	if(retval != 0){
		LOG_ERR("Failed to initialize nrf modem lib (%d)",retval);
		k_msleep(5000);
		return -1;
	}

	retval = connect_to_network();
	if(retval != 1){
		LOG_DBG("Connecting failed with %d",retval);
	}


	handle = sms_register_listener(sms_callback, NULL);
	if (handle) {
		printk("sms_register_listener returned err: %d\n", handle);
		return 0;
	}

	printk("SMS sample is ready for receiving messages\n");

	while(1){
		respond_to_payload();
		k_msleep(10000);
		

		};
		return 0;
	}
```

## src/connect_example.c
```c
#include <stdint.h>
#include <stdlib.h>
#include "connect_example.h"
#include <nrf_modem_at.h>
#include <modem/at_monitor.h>
#include <zephyr/logging/log.h>

/*Register logging for the module*/
LOG_MODULE_REGISTER(connect_example, LOG_LEVEL_DBG);

/* Network registration status semaphore */
static K_SEM_DEFINE(scan_status, 0, 1);

static int connected = 0;
/* AT monitor for +CEREG notifications */
AT_MONITOR(network_registration, "+CEREG", cereg_mon);
static void cereg_mon(const char *notif)
{
    LOG_INF("%s",notif);
    int32_t cereg_status;
    cereg_status = atoi(notif + strlen("+CEREG: "));
    if (cereg_status == 5 || cereg_status == 1) { //1=home network, 5 = roaming
        connected = 1;
    	k_sem_give(&scan_status);
	}
    if (cereg_status == 90) { //Sim failure
        connected = 0;
    	k_sem_give(&scan_status);
	}
}


static int32_t cfun_control(int mode)
{
    int32_t err;
    LOG_INF("Setting modem functional mode to %d",mode);
    err = nrf_modem_at_printf("AT+CFUN=%d", mode);
    if (err == 0) {
        LOG_INF("ok");
    } else if (err < 0) {
        LOG_INF("Error %d",errno);
    } else {
        /* Command was sent, but response is not "OK" */
        switch(nrf_modem_at_err_type(err)) {
        case NRF_MODEM_AT_ERROR:
            /* Modem returned "ERROR" */
            LOG_ERR("error");
            break;
        case NRF_MODEM_AT_CME_ERROR:
            /* Modem returned "+CME ERROR" */
            LOG_ERR("cme error: %d", nrf_modem_at_err(err));
            break;
        case NRF_MODEM_AT_CMS_ERROR:
            /* Modem returned "+CMS ERROR" */
            LOG_ERR("cms error: %d", nrf_modem_at_err(err));
            break;
        }
    }
    return err;
}

int32_t sim_activation_status()
{
    int32_t status;
    //Polling way to check state
    LOG_INF("Waiting for SIM activation");
    for(int i=0;i<60;i++){
        nrf_modem_at_scanf("AT%XSIM?", "%%XSIM: %d", &status);
        if(status == 1)break;
        k_msleep(1000);
    }
    return status;
}

int32_t connect_to_network()
{
    int32_t retval;
    int32_t sim_status = 0;
    char resp[256];
    char resp1[256];
    
    
    //Read modem firmware version
    retval = nrf_modem_at_scanf("AT+CGMR","%s",resp);
    if(retval == 1){
        LOG_INF("Modem fw version: %s",resp);
    }

    //Read modem firmware version
    retval = nrf_modem_at_scanf("AT+CPIN","%s",resp1);
    if(retval == 1){
        LOG_INF("PIN attempts %s",resp1);
    }

    //Register to cereg notifications
    retval = nrf_modem_at_printf("AT+CEREG=%d",CEREG_NOTIFICATION_LEVEL);
	if (retval) {
		LOG_INF("AT+CEREG failed");
		return -1;
	}

    //Set device to functional mode 1 (Full opeartion) Enabled services depend on AT%XSYSTEMMODE settings.
    retval = cfun_control(MODEM_FUNC_MODE_FULL);
    if(retval < 0){
        LOG_ERR("Connect failed");
        return -1;
    }

    sim_status = sim_activation_status();

    if(sim_status == 1){
        LOG_INF("SIM Activated, reading ICCID");
        retval = nrf_modem_at_cmd(resp, sizeof(resp), "AT%%XICCID");
        if (!retval) {
            LOG_INF("ICCID: %s",resp);
        }
    }

    //Wait until connected or timeout
    LOG_INF("Waiting for network");
	retval = k_sem_take(&scan_status, K_SECONDS(60*10));

    if(!connected || retval != 0){
        LOG_INF("Connect attempt failed, transition to flight mode");
        cfun_control(MODEM_FUNC_MODE_FLIGHT);
        return 0;
    }

    LOG_INF("Connected");
     

    
	

    return 1;
}
```

## src/connect_example.h
```c
#ifndef CONNECT_EXAMPLE_H
#define CONNECT_EXAMPLE_H
/*Module is intented to be a minimal example of using at- commands via nrf_modem_lib AT api*/

#define CEREG_NOTIFICATION_LEVEL    5
typedef enum MODEM_FUNCTIONAL_MODE_E
{
    MODEM_FUNC_MODE_ERROR               =   -1,
    MODEM_FUNC_MODE_POWEROFF            =   0,
    MODEM_FUNC_MODE_FULL                =   1,
    MODEM_FUNC_MODE_RECEIVE             =   2,
    MODEM_FUNC_MODE_FLIGHT              =   4,
    MODEM_FUNC_MODE_DEACTIVATE_LTE      =   20,
    MODEM_FUNC_MODE_ACTIVATE_LTE        =   21,
    MODEM_FUNC_MODE_DEACTIVATE_GNSS     =   30,
    MODEM_FUNC_MODE_ACTIVATE_GNSS       =   31,
    MODEM_FUNC_MODE_DEACTIVATE_UICC     =   40,
    MODEM_FUNC_MODE_ACTIVATE_UICC       =   41,
    MODEM_FUNC_MODE_FLIGHT_WITH_UICC    =   44
} MODEM_FUNCTIONAL_MODE;

/*@brief Connect to network.
@note If connection attempt fails, modem is set to flight mode
@return Returns -1 on error, 0 if connection was not established or 1 if connection was made*/
int32_t connect_to_network();

#endif
```
